## main/Kconfig.projbuild
```kconfig
menu "HackWatch"
  config INCLUDE_WIFI
    bool "Include WiFi tools"
    default y

  config WIFI_SCANNER
    depends on INCLUDE_WIFI
    bool "WiFi scanner"
    default y

  config WIFI_CHANNELS
    depends on INCLUDE_WIFI
    bool "WiFi channels scanner"
    default y

  config WIFI_ROGUEAP
    depends on INCLUDE_WIFI
    bool "Rogue AP generator"
    default y
  
  config WIFI_DEAUTH
    depends on INCLUDE_WIFI
    bool "Deauth"
    default y

  config INCLUDE_BLE
    bool "Include Bluetooth Low Energy tools"
    default y

  config BLE_SCANNER
    depends on INCLUDE_BLE
    bool "Bluetooth Low Energy scanner"
    default y

  config INCLUDE_IR
    bool "Infrared tools"
    default y

  config INCLUDE_ANTP
    bool "ANT+ tools"
    default n
endmenu
```
